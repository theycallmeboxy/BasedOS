## buildroot/package/flac13/Config.in
```kconfig
config BR2_PACKAGE_FLAC13
	bool "flac13"
	select BR2_PACKAGE_LIBOGG
	help
	  FLAC 1.3's library, libFLAC.so.8, beside Buildroot's FLAC 1.4
	  (libFLAC.so.12): the ABI that PortMaster ports built on older
	  systems link (A7Xpg's SDL_mixer and 12 more, docs/portmaster-libs.md).
	  The library only: no headers, no tools.

	  https://xiph.org/flac/
```
